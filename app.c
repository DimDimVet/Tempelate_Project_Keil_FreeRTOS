#include "stm32f4xx.h"                  // Device header
#include "FreeRTOS.h"
#include "task.h"

/*Зададим максимальное число*/
#define DELAY_COUNT (0xfffff)

/*Прототип задачи*/
void Task1(void *pvParameters);
void Task2(void *pvParameters);
/*-----------------------------------------------------------*/

int main ()
{
	/*Инициализация системы*/
	SystemInit();

  /*Инициализация RCC*/
  SystemCoreClockUpdate();
	
	/*Создать задачи*/
  xTaskCreate(Task1, /*Указатель на прототип задачи*/
							"Task 1", /*Текстовое имя задачи*/
							240, /*Выделяем стек(в словах)*/
							NULL, /*Параметров задачи нет*/
							1, /*Приоритет:1*/
							NULL); /*Дескриптор задач не используем*/

	xTaskCreate(Task2, "Task 2", 240, NULL, 1, NULL);
	
	/*Запуск планировщика, начало выполнения задач*/
	vTaskStartScheduler();

	/*Если провалились на главный цикл, значит либо ошибки в задачах, либо переполнения стека*/
	while(1)
	{
	}
	
	return 0;
}

/*-----------------------------------------------------------*/

void Task1(void *pvParameters)
{
	/*Основной цикл в задаче*/
	while(1)
	{
		/*Просто задержка*/
		for(uint32_t i = 0; i < DELAY_COUNT; i++ )
		{
		}
	}

} 
/*-----------------------------------------------------------*/

void Task2(void *pvParameters)
{
	/*Основной цикл в задаче*/
	while(1)
	{
		/*Просто задержка*/
		for(uint32_t i = 0; i < DELAY_COUNT; i++ )
		{
		}
	}
}
/*-----------------------------------------------------------*/
/*Реализуем обработчики событий*/
void vApplicationMallocFailedHook()
{
	/*Срабатывает при сбое вызова RTOS при вызове задачи или недостаток памяти*/
	while(1)
	{

	}
}
/*-----------------------------------------------------------*/

void vApplicationStackOverflowHook(xTaskHandle *pxTask, char *pcTaskName)
{
	/*Срабатывает при переполнении стека задачи*/
	while(1)
	{

	}
}
/*-----------------------------------------------------------*/

void vApplicationIdleHook()
{
  /*Не используем*/
}
/*-----------------------------------------------------------*/

void vApplicationTickHook()
{
  /*Не используем*/
}